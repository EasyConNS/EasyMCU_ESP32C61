## main/Kconfig.projbuild
```kconfig
menu "NSController Configuration"

    config MCU_DEBUG
        bool "Enable MCU debug logging"
        default n
        help
            Enable detailed debug output for MCU operations.

    choice UART_PROTOCOL_CHOICE
        prompt "UART Protocol"
        default UART_PROTOCOL_SIMPLE
        help
            Select the UART communication protocol.

        config UART_PROTOCOL_SIMPLE
            bool "Simple protocol (default)"

        config UART_PROTOCOL_EASYCON
            bool "EasyCon protocol"
    endchoice

    config UART_PROTOCOL
        int
        default 0 if UART_PROTOCOL_SIMPLE
        default 1 if UART_PROTOCOL_EASYCON

    config UART_RX_PIN
        int "UART RX Pin (GPIO)"
        default 4
        help
            GPIO number for UART RX pin. Default is GPIO4.

    config UART_TX_PIN
        int "UART TX Pin (GPIO)"
        default 5
        help
            GPIO number for UART TX pin. Default is GPIO5.

endmenu
```

## sdkconfig.defaults.esp32c61
```kconfig
# Test on ESP32-C61-DevKitC-1-N8R2

CONFIG_IDF_TARGET="esp32c61"
CONFIG_BT_ENABLED=y
CONFIG_BT_NIMBLE_ENABLED=y

# use jtag for transport layer
CONFIG_TRANSPORT_LAYER_USB_SERIAL_JTAG=y
CONFIG_ESP_CONSOLE_SECONDARY_NONE=y

# 15ms is OK, if mbuf memory not released, maybe set to 20ms
CONFIG_HID_REPORT_INTERVAL=15

# FLASH
CONFIG_ESPTOOLPY_FLASHSIZE_8MB=y
CONFIG_PARTITION_TABLE_CUSTOM=y
CONFIG_PARTITION_TABLE_CUSTOM_FILENAME="partitions_n2c.csv"
```
